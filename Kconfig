## drivers/gpio/Kconfig.et6416
```kconfig
# Copyright (c) 2021 Abel Sensors
# SPDX-License-Identifier: Apache-2.0

menuconfig GPIO_ET6416
	bool "ET6416 I2C-based GPIO chip"
	default y
	depends on DT_HAS_TC_ET6416_ENABLED
	depends on I2C
	help
	  Enable driver for ET6416 I2C-based GPIO chip.

if GPIO_ET6416

config GPIO_ET6416_INIT_PRIORITY
	int "Init priority"
	default 80
	help
	  Device driver initialization priority.

endif # GPIO_ET6416
```

## drivers/gpio/Kconfig.et64c16
```kconfig
# Copyright (c) 2021 Abel Sensors
# SPDX-License-Identifier: Apache-2.0

menuconfig GPIO_ET64C16
	bool "ET64C16 I2C-based GPIO chip"
	default y
	depends on DT_HAS_TC_ET64C16_ENABLED
	depends on I2C
	help
	  Enable driver for ET64C16 I2C-based GPIO chip.

if GPIO_ET64C16

config GPIO_ET64C16_INIT_PRIORITY
	int "Init priority"
	default 80
	help
	  Device driver initialization priority.

endif # GPIO_ET64C16
```

## dts/bindings/gpio/tc,et6416.yaml
```yaml
# Copyright (c) 2021 Abel Sensors
# SPDX-License-Identifier: Apache-2.0

description: ET6416 I2C-based GPIO expander

compatible: "tc,et6416"

include: [gpio-controller.yaml, i2c-device.yaml]

properties:
  "#gpio-cells":
    const: 2

gpio-cells:
  - pin
  - flags
```

## dts/bindings/gpio/tc,et64c16.yaml
```yaml
# Copyright (c) 2021 Abel Sensors
# SPDX-License-Identifier: Apache-2.0

description: ET64C16 I2C-based GPIO expander

compatible: "tc,et64c16"

include: [gpio-controller.yaml, i2c-device.yaml]

properties:
  "#gpio-cells":
    const: 2

gpio-cells:
  - pin
  - flags
```
