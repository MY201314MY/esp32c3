## drivers/modem/Kconfig
```kconfig
# Modem configuration options

# Copyright (c) 2018 Foundries.io
# SPDX-License-Identifier: Apache-2.0

menuconfig TELIT_MODEM
	bool "Modem drivers"
    select MODEM_MODULES
	select MODEM_PIPE
	select MODEM_BACKEND_UART
	select RING_BUFFER
	help
	  Enable config options for modem drivers.
```

## drivers/modem/Kconfig.telit
```kconfig
# Copyright (C) Telit Communications S.p.A. Italy - All Rights Reserved.
# See LICENSE file in the project root for full license information.
# SPDX-License-Identifier: Apache-2.0

menuconfig MODEM_TELIT_CELLULAR_MODEM
	default y
	depends on DT_HAS_TELIT_CELLULAR_MODEM_ENABLED
	bool "Telit MEX10G1 mdoem uart transmit and receive."
	select PM_DEVICE
	select RING_BUFFER
	select UART_INTERRUPT_DRIVEN
```

## dts/bindings/modem/telit,cellular-modem.yaml
```yaml
# Copyright(c) 2023 Jeff Welder (Ellenby Technologies, Inc.)
# SPDX-License-Identifier: Apache-2.0

description: Telit Cellular Modem

compatible: "telit,cellular-modem"

include: uart-device.yaml

properties:
  mdm-power-gpios:
    type: phandle-array

  mdm-extern-power-gpios:
    type: phandle-array

  mdm-reset-gpios:
    type: phandle-array

  mdm-status-gpios:
    type: phandle-array

  mdm-dtr-gpios:
    type: phandle-array

  mdm-ri-gpios:
    type: phandle-array
```

## dts/bindings/modem/telit,mex10g1.yaml
```yaml
# Copyright (C) Telit Communications S.p.A. Italy - All Rights Reserved.

description: Telit Cellular Modem

compatible: "telit,cellular-modem"

include: uart-device.yaml

properties:
  mdm-power-gpios:
    type: phandle-array
     
  mdm-extern-power-gpios:
    type: phandle-array

  mdm-reset-gpios:
    type: phandle-array

  mdm-status-gpios:
    type: phandle-array
```
